## CMakeLists.txt
```
# SPDX-License-Identifier: Apache-2.0

cmake_minimum_required(VERSION 3.20.0)

find_package(Zephyr REQUIRED HINTS $ENV{ZEPHYR_BASE})
project(sandbox)

target_sources(app PRIVATE src/sandbox.c)

include(${ZEPHYR_BASE}/samples/net/common/common.cmake)

set(gen_dir ${ZEPHYR_BINARY_DIR}/include/generated/)
```

## prj.conf
```kconfig
# Logging with RTT
CONFIG_PRINTK=y
CONFIG_USE_SEGGER_RTT=y
CONFIG_RTT_CONSOLE=y
CONFIG_UART_CONSOLE=n
```

## src/sandbox.c
```c
#include <zephyr/kernel.h>

int main(void) {

  printk("What's up?\n");

  while(true) {
    k_msleep(1000);
    printk("I'm alive...\n");
  }

  return 0;
}
```
