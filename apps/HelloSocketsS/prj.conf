## prj.conf
```kconfig
# Generic networking options
CONFIG_NETWORKING=y
CONFIG_NET_UDP=y
CONFIG_NET_TCP=y
CONFIG_NET_IPV6=y
CONFIG_NET_IPV4=y
CONFIG_NET_SOCKETS=y
# CONFIG_ZVFS_POLL_MAX=5
CONFIG_NET_CONNECTION_MANAGER=y

CONFIG_POSIX_API=y

# Kernel options
CONFIG_MAIN_STACK_SIZE=2048
CONFIG_ENTROPY_GENERATOR=y
CONFIG_TEST_RANDOM_GENERATOR=y
CONFIG_INIT_STACKS=y
CONFIG_MAX_THREAD_BYTES=3

# Logging
CONFIG_NET_LOG=y
CONFIG_LOG=y
CONFIG_NET_STATISTICS=y
CONFIG_PRINTK=y

# Network buffers
CONFIG_NET_PKT_RX_COUNT=16
CONFIG_NET_PKT_TX_COUNT=16
CONFIG_NET_BUF_RX_COUNT=80
CONFIG_NET_BUF_TX_COUNT=80
CONFIG_NET_CONTEXT_NET_PKT_POOL=y

# IP address options
CONFIG_NET_IF_UNICAST_IPV6_ADDR_COUNT=3
CONFIG_NET_IF_MCAST_IPV6_ADDR_COUNT=4
CONFIG_NET_MAX_CONTEXTS=10
CONFIG_NET_IF_MAX_IPV6_COUNT=3
CONFIG_NET_IF_MAX_IPV4_COUNT=3

# Network shell
CONFIG_NET_SHELL=y

# The addresses are selected so that qemu<->qemu connectivity works ok.
# For linux<->qemu connectivity, create a new conf file and swap the
# addresses (so that peer address is ending to 2).
CONFIG_NET_CONFIG_SETTINGS=y
CONFIG_NET_CONFIG_NEED_IPV6=y
CONFIG_NET_CONFIG_MY_IPV6_ADDR="2001:db8::2"
CONFIG_NET_CONFIG_PEER_IPV6_ADDR="2001:db8::1"
CONFIG_NET_CONFIG_NEED_IPV4=y
CONFIG_NET_CONFIG_MY_IPV4_ADDR="192.0.2.2"
CONFIG_NET_CONFIG_PEER_IPV4_ADDR="192.0.2.1"
CONFIG_SYSTEM_WORKQUEUE_STACK_SIZE=2048
```

## overlay-802154.conf
```kconfig
CONFIG_BT=n

# Disable TCP and IPv4 (TCP disabled to avoid heavy traffic)
CONFIG_NET_TCP=y
CONFIG_NET_UDP=y
CONFIG_NET_IPV4=n
CONFIG_NET_L2_IEEE802154_FRAGMENT_REASS_CACHE_SIZE=8


CONFIG_NET_CONFIG_NEED_IPV6=y
CONFIG_NET_CONFIG_NEED_IPV4=n
CONFIG_NET_CONFIG_MY_IPV4_ADDR=""
CONFIG_NET_CONFIG_PEER_IPV4_ADDR=""

CONFIG_NET_L2_IEEE802154=y
CONFIG_NET_L2_IEEE802154_SHELL=y
CONFIG_NET_L2_IEEE802154_LOG_LEVEL_INF=y

CONFIG_NET_CONFIG_IEEE802154_CHANNEL=26

CONFIG_SYSTEM_WORKQUEUE_STACK_SIZE=2048
```

## nrf52840dk_nrf52840.overlay
```dts
&radio {
    status = "okay";
};

&ieee802154 {
    status = "okay";
};
```

## src/main.c
```c
#include <zephyr/kernel.h>
#include <zephyr/net/socket.h>
#include <zephyr/net/net_mgmt.h>
#include <zephyr/net/net_event.h>
#include <zephyr/net/conn_mgr_monitor.h>
#include <zephyr/logging/log.h>

LOG_MODULE_REGISTER(tcp_server, LOG_LEVEL_DBG);

#define SERVER_PORT 4242
#define RECV_BUF_SIZE 1280

static K_SEM_DEFINE(run_app, 0, 1);
static bool connected = false;

static void event_handler(struct net_mgmt_event_callback *cb,
			  uint32_t mgmt_event, struct net_if *iface)
{
	if (mgmt_event == NET_EVENT_L4_CONNECTED) {
		printk("Network connected");
		connected = true;
		k_sem_give(&run_app);
	} else if (mgmt_event == NET_EVENT_L4_DISCONNECTED) {
		printk("Network disconnected");
		connected = false;
		k_sem_reset(&run_app);
	}
}

int main(void)
{
	static struct net_mgmt_event_callback mgmt_cb;
	struct sockaddr_in6 bind_addr, client_addr;
	socklen_t client_addr_len;
	int listen_sock, client_sock;
	char recv_buf[RECV_BUF_SIZE];
	int ret, optval;

	printk("Starting TCP echo server");

	/* Register network event callback */
	net_mgmt_init_event_callback(&mgmt_cb, event_handler,
				     NET_EVENT_L4_CONNECTED |
				     NET_EVENT_L4_DISCONNECTED);
	net_mgmt_add_event_callback(&mgmt_cb);
	conn_mgr_mon_resend_status();

	/* Wait for network */
	printk("Waiting for network...");
	k_sem_take(&run_app, K_FOREVER);

	/* Create socket */
	listen_sock = socket(AF_INET6, SOCK_STREAM, IPPROTO_TCP);
	if (listen_sock < 0) {
		printk("socket() failed: %d", errno);
		return -1;
	}

	/* IPv6-only (don't map to IPv4) */
	optval = 1;
	setsockopt(listen_sock, IPPROTO_IPV6, IPV6_V6ONLY,
		   &optval, sizeof(optval));

	/* Bind */
	memset(&bind_addr, 0, sizeof(bind_addr));
	bind_addr.sin6_family = AF_INET6;
	bind_addr.sin6_port = htons(SERVER_PORT);
	bind_addr.sin6_addr = in6addr_any;

	ret = bind(listen_sock, (struct sockaddr *)&bind_addr,
		   sizeof(bind_addr));
	if (ret < 0) {
		printk("bind() failed: %d", errno);
		close(listen_sock);
		return -1;
	}

	/* Listen */
	ret = listen(listen_sock, 1);
	if (ret < 0) {
		printk("listen() failed: %d", errno);
		close(listen_sock);
		return -1;
	}

	printk("Listening on port %d", SERVER_PORT);

	/* Accept loop */
	while (connected) {
		client_addr_len = sizeof(client_addr);
		
		printk("Waiting for client...");
		client_sock = accept(listen_sock,
				     (struct sockaddr *)&client_addr,
				     &client_addr_len);
		if (client_sock < 0) {
			printk("accept() failed: %d", errno);
			continue;
		}

		printk("Client connected");

		/* Echo loop */
		while (1) {
			ret = recv(client_sock, recv_buf, sizeof(recv_buf), 0);
			if (ret <= 0) {
				if (ret == 0) {
					printk("Client disconnected");
				} else {
					printk("recv() failed: %d", errno);
				}
				break;
			}

			printk("Received %d bytes", ret);

			/* Send all data back */
			int sent = 0;
			while (sent < ret) {
				int n = send(client_sock, recv_buf + sent,
					     ret - sent, 0);
				if (n < 0) {
					printk("send() failed: %d", errno);
					goto close_client;
				}
				sent += n;
			}

			LOG_DBG("Echoed %d bytes", ret);
		}

close_client:
		close(client_sock);
	}

	close(listen_sock);
	return 0;
}
```
