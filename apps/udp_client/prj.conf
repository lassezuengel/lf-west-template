## CMakeLists.txt
```
# SPDX-License-Identifier: Apache-2.0

cmake_minimum_required(VERSION 3.20.0)

find_package(Zephyr REQUIRED HINTS $ENV{ZEPHYR_BASE})
project(sockets_echo_client)

if(CONFIG_NET_SOCKETS_SOCKOPT_TLS AND
   CONFIG_MBEDTLS_KEY_EXCHANGE_PSK_ENABLED AND
   (CONFIG_NET_SAMPLE_PSK_HEADER_FILE STREQUAL "dummy_psk.h"))
  add_custom_target(development_psk
    COMMAND ${CMAKE_COMMAND} -E echo "----------------------------------------------------------"
    COMMAND ${CMAKE_COMMAND} -E echo "--- WARNING: Using dummy PSK! Only suitable for        ---"
    COMMAND ${CMAKE_COMMAND} -E echo "--- development. Set NET_SAMPLE_PSK_HEADER_FILE to use ---"
    COMMAND ${CMAKE_COMMAND} -E echo "--- own pre-shared key.                                ---"
    COMMAND ${CMAKE_COMMAND} -E echo "----------------------------------------------------------"
  )
  add_dependencies(app development_psk)
endif()

target_sources(                     app PRIVATE src/udp-client.c)

include(${ZEPHYR_BASE}/samples/net/common/common.cmake)

set(gen_dir ${ZEPHYR_BINARY_DIR}/include/generated/)
```

## Kconfig
```
# Private config options for echo-client sample app

# Copyright (c) 2018 Intel Corporation
# SPDX-License-Identifier: Apache-2.0

mainmenu "Networking echo-client sample application"

config NET_SAMPLE_SEND_ITERATIONS
	int "Send sample data this many times"
	default 0
	help
	  Send sample data this many times before exiting. A value of
	  zero means that the sample application is run forever.

config UDP_CLIENT_EXPECT_REPLIES
	bool "Expect UDP replies from server"
	default y
	help
	  If enabled, the client waits for a reply packet after each
	  outgoing packet. If disabled, the client sends packets without
	  waiting for responses.

config UDP_CLIENT_REPLY_TIMEOUT_MS
	int "Reply wait timeout in milliseconds"
	range 1 60000
	default 2000
	depends on UDP_CLIENT_EXPECT_REPLIES
	help
	  Maximum time to wait for a server response after sending a
	  UDP packet.

config UDP_CLIENT_SEND_DELAY_MS
	int "Delay between outgoing UDP packets in milliseconds"
	range 0 60000
	default 2000
	help
	  Delay after each sent packet before sending the next packet.
	  Set to 0 for maximum transmit rate.

source "Kconfig.zephyr"
```

## prj.conf
```kconfig
# Generic networking options
CONFIG_NETWORKING=y
CONFIG_NET_TCP=y
CONFIG_NET_IPV6=y
CONFIG_NET_SOCKETS=y
CONFIG_NET_CONNECTION_MANAGER=y

CONFIG_POSIX_API=y

# Kernel options
CONFIG_MAIN_STACK_SIZE=2048
CONFIG_INIT_STACKS=y

# Logging
CONFIG_NET_LOG=y
CONFIG_LOG=y
CONFIG_PRINTK=y
# Logging with RTT
CONFIG_USE_SEGGER_RTT=y
CONFIG_RTT_CONSOLE=y
CONFIG_UART_CONSOLE=n


# Network buffers
CONFIG_NET_PKT_RX_COUNT=16
CONFIG_NET_PKT_TX_COUNT=16
CONFIG_NET_BUF_RX_COUNT=80
CONFIG_NET_BUF_TX_COUNT=80
CONFIG_NET_CONTEXT_NET_PKT_POOL=y

# IP address options
CONFIG_NET_IF_UNICAST_IPV6_ADDR_COUNT=3
CONFIG_NET_IF_MCAST_IPV6_ADDR_COUNT=4
CONFIG_NET_MAX_CONTEXTS=10
CONFIG_NET_IF_MAX_IPV6_COUNT=3

# Network shell
CONFIG_NET_SHELL=y

CONFIG_NET_CONFIG_SETTINGS=y
CONFIG_NET_CONFIG_NEED_IPV6=y
CONFIG_NET_CONFIG_MY_IPV6_ADDR="fd01::1234"
CONFIG_NET_CONFIG_PEER_IPV6_ADDR="fd01::1"
CONFIG_SYSTEM_WORKQUEUE_STACK_SIZE=2048

# Application behavior options
CONFIG_UDP_CLIENT_EXPECT_REPLIES=n
CONFIG_UDP_CLIENT_REPLY_TIMEOUT_MS=2000
CONFIG_UDP_CLIENT_SEND_DELAY_MS=0


CONFIG_NET_IPV6_ND=n
CONFIG_NET_IPV6_NBR_CACHE=n
```

## overlay-802154.conf
```kconfig
CONFIG_BT=n

# Disable TCP and IPv4
CONFIG_NET_TCP=n
CONFIG_NET_UDP=y
CONFIG_NET_IPV4=n
CONFIG_NET_L2_IEEE802154_FRAGMENT_REASS_CACHE_SIZE=8

CONFIG_NET_CONFIG_NEED_IPV6=y
CONFIG_NET_CONFIG_NEED_IPV4=n
CONFIG_NET_CONFIG_MY_IPV4_ADDR=""
CONFIG_NET_CONFIG_PEER_IPV4_ADDR=""

CONFIG_NET_L2_IEEE802154=y
CONFIG_NET_L2_IEEE802154_SHELL=y

CONFIG_NET_CONFIG_IEEE802154_CHANNEL=26
```

## src/common.h
```c
/*
 * Copyright (c) 2017 Intel Corporation.
 * Copyright (c) 2018 Nordic Semiconductor ASA.
 *
 * SPDX-License-Identifier: Apache-2.0
 */

#include <zephyr/kernel.h>

/* Value of 0 will cause the IP stack to select next free port */
#define MY_PORT 0

#define PEER_PORT 4242

/* Turn off the progress printing so that shell can be used.
 * Set to true if you want to see progress output.
 */
#define PRINT_PROGRESS false

#if defined(CONFIG_USERSPACE)
#include <zephyr/app_memory/app_memdomain.h>
extern struct k_mem_partition app_partition;
extern struct k_mem_domain app_domain;
#define APP_BMEM K_APP_BMEM(app_partition)
#define APP_DMEM K_APP_DMEM(app_partition)
#else
#define APP_BMEM
#define APP_DMEM
#endif

#if defined(CONFIG_NET_TC_THREAD_PREEMPTIVE)
#define THREAD_PRIORITY K_PRIO_PREEMPT(8)
#else
#define THREAD_PRIORITY K_PRIO_COOP(CONFIG_NUM_COOP_PRIORITIES - 1)
#endif

struct sample_data {
	const char *proto;
	int udp_sock;
	int counter;
};

#if !defined(CONFIG_NET_CONFIG_PEER_IPV6_ADDR)
#define CONFIG_NET_CONFIG_PEER_IPV6_ADDR ""
#endif

extern const char lorem_ipsum[];
extern const int ipsum_len;
```

## src/udp-client.c
```c
/* echo-client.c - Simplified IPv6 TCP echo client */

#include <zephyr/logging/log.h>
LOG_MODULE_REGISTER(net_udp_client_sample, LOG_LEVEL_INF);

#include <errno.h>
#include <stdio.h>
#include <zephyr/kernel.h>

#include <zephyr/posix/sys/eventfd.h>
#include <zephyr/posix/poll.h>
#include <zephyr/sys/util.h>

#include <zephyr/net/conn_mgr_monitor.h>
#include <zephyr/net/net_event.h>
#include <zephyr/net/net_mgmt.h>
#include <zephyr/net/socket.h>

#include "common.h"

#define APP_BANNER "Run UDP echo client"

#define INVALID_SOCK (-1)

#define EVENT_MASK (NET_EVENT_L4_CONNECTED | NET_EVENT_L4_DISCONNECTED)

const char lorem_ipsum[] = "LOREM_IPSUM";
const int ipsum_len = sizeof(lorem_ipsum) - 1;

APP_DMEM struct sample_data conf = {
  .proto = "IPv6",
  .counter = 0,
};

static APP_BMEM bool connected;

K_SEM_DEFINE(run_app, 0, 1);

static struct net_mgmt_event_callback mgmt_cb;

static int start_udp(void);
static void stop_udp(void);

// Sets up network event handler for connection management.
// On connection, it gives the semaphore to allow the client to run.
static void event_handler(struct net_mgmt_event_callback *cb,
                          uint32_t mgmt_event, struct net_if *iface) {
  if ((mgmt_event & EVENT_MASK) != mgmt_event) {
    return;
  }

  if (mgmt_event == NET_EVENT_L4_CONNECTED) {
    LOG_INF("Network connected");
    connected = true;
    k_sem_give(&run_app);
    return;
  }

  if (mgmt_event == NET_EVENT_L4_DISCONNECTED) {
    LOG_INF("Network disconnected");
    connected = false;
    k_sem_reset(&run_app);
    return;
  }
}

// Initializes network manager and connection event callback.
static void init_network_manager(void) {
  if (IS_ENABLED(CONFIG_NET_CONNECTION_MANAGER)) {
    net_mgmt_init_event_callback(&mgmt_cb,
                                 event_handler, EVENT_MASK);
    net_mgmt_add_event_callback(&mgmt_cb);

    conn_mgr_mon_resend_status();
  } else {
    connected = true;
    k_sem_give(&run_app);
  }
}

int main(void) {
  LOG_INF(APP_BANNER);
  printk("What's up? Client running!\n");

  init_network_manager();

  k_thread_priority_set(k_current_get(), THREAD_PRIORITY);

  int i = 0;
  int ret;

  while (true) {
    k_sem_take(&run_app, K_FOREVER);

    LOG_INF("Starting UDP sample run %d\n", ++i);
    ret = start_udp();
    if (ret < 0) {
      LOG_ERR("UDP sample failed: %d", -ret);
    }

    stop_udp();
  }

  return 0;
}

/* UDP implementation */
#define RECV_BUF_SIZE 128

static void log_client_tx_rate(uint32_t *packets_last_sec,
                               int64_t *last_log_ms) {
  int64_t now = k_uptime_get();

  while ((now - *last_log_ms) >= 1000) {
    LOG_INF("Client->server rate: sent %u packets in last second",
            *packets_last_sec);
    *packets_last_sec = 0;
    *last_log_ms += 1000;
  }
}

static ssize_t sendall(const void *buf, size_t len, struct sockaddr *addr, socklen_t addrlen) {
  while (len) {
    ssize_t out_len = sendto(conf.udp_sock, buf, len, 0, addr, addrlen);

    if (out_len < 0) {
      return out_len;
    }
    buf = (const char *)buf + out_len;
    len -= out_len;
  }

  return 0;
}

static int process_udp_proto(struct sockaddr *addr, socklen_t addrlen) {
  int ret;
  uint32_t tx_packets_last_sec = 0;
  int64_t last_rate_log_ms = k_uptime_get();

  while(true) {
    if (++conf.counter % 1000 == 0U) {
      LOG_INF("%s UDP: Exchanged %u packets", conf.proto,
              conf.counter);
    }

    LOG_DBG("Sending stuff!");
    ret = sendall(lorem_ipsum, 12, addr, addrlen);
    if (ret < 0) {
      LOG_ERR("%s UDP: Failed to send data, errno %d", conf.proto,
              errno);
      log_client_tx_rate(&tx_packets_last_sec, &last_rate_log_ms);
      k_msleep(100);
      continue;
    }

    tx_packets_last_sec++;
    log_client_tx_rate(&tx_packets_last_sec, &last_rate_log_ms);

#ifndef CONFIG_UDP_CLIENT_EXPECT_REPLIES
      LOG_DBG("Reply wait disabled by CONFIG_UDP_CLIENT_EXPECT_REPLIES");
#else 
      char recv_buf[RECV_BUF_SIZE];
      size_t recv_buf_size = sizeof(recv_buf);
      int wait_remaining_ms = CONFIG_UDP_CLIENT_REPLY_TIMEOUT_MS;
      bool got_reply = false;

      struct pollfd fds[1];
      fds[0].fd = conf.udp_sock;
      fds[0].events = POLLIN;

      while (wait_remaining_ms > 0) {
        int64_t now = k_uptime_get();
        int64_t until_rate_log = 1000 - (now - last_rate_log_ms);
        int poll_timeout_ms;

        if (until_rate_log <= 0) {
          log_client_tx_rate(&tx_packets_last_sec, &last_rate_log_ms);
          continue;
        }

        poll_timeout_ms = MIN(wait_remaining_ms, (int)until_rate_log);
        ret = poll(fds, 1, poll_timeout_ms);
        if (ret < 0) {
          LOG_ERR("Poll failed: %d", -errno);
          return -errno;
        }

        wait_remaining_ms -= poll_timeout_ms;
        log_client_tx_rate(&tx_packets_last_sec, &last_rate_log_ms);

        if (ret == 0) {
          continue;
        }

        ret = recv(conf.udp_sock, recv_buf, recv_buf_size - 1, 0);
        if (ret < 0) {
          LOG_ERR("Receive failed: %d", -errno);
          break;
        }

        recv_buf[ret] = '\0';
        LOG_INF("Received %d bytes: %s", ret, recv_buf);
        got_reply = true;
        break;
      }

      if (!got_reply) {
        LOG_WRN("Timeout: no response received within %d ms",
                CONFIG_UDP_CLIENT_REPLY_TIMEOUT_MS);
      }
#endif

    int send_delay_ms = CONFIG_UDP_CLIENT_SEND_DELAY_MS;
    while (send_delay_ms > 0) {
      int64_t now = k_uptime_get();
      int64_t until_rate_log = 1000 - (now - last_rate_log_ms);
      int sleep_ms;

      if (until_rate_log <= 0) {
        log_client_tx_rate(&tx_packets_last_sec, &last_rate_log_ms);
        continue;
      }

      sleep_ms = MIN(send_delay_ms, (int)until_rate_log);
      k_msleep(sleep_ms);
      send_delay_ms -= sleep_ms;
      log_client_tx_rate(&tx_packets_last_sec, &last_rate_log_ms);
    }
  }

  return ret;
}

// Starts UDP connection to the given address and port.
static int start_udp_proto(sa_family_t family,
                           struct sockaddr *addr, socklen_t addrlen) {
  int ret;

  conf.udp_sock = socket(family, SOCK_DGRAM, IPPROTO_UDP);
  if (conf.udp_sock < 0) {
    LOG_ERR("Failed to create UDP socket (%s): %d", conf.proto,
            errno);
    return -errno;
  }

  // We connect to the server address so that we only see traffic from it
  // and TODO: can use send() and recv() instead of sendto() and recvfrom().
  ret = connect(conf.udp_sock, addr, addrlen);
  if (ret < 0) {
    LOG_ERR("Cannot connect to UDP remote (%s): %d", conf.proto,
            errno);
    return -errno;
  }

  ret = process_udp_proto(addr, addrlen);
  if (ret < 0) {
    LOG_ERR("UDP processing failed (%s): %d", conf.proto,
            -ret);
  }

  return ret;
}

// Starts UDP connection to the server.
static int start_udp(void) {
  int ret = 0;
  struct sockaddr_in6 addr6;

  addr6.sin6_family = AF_INET6;
  addr6.sin6_port = htons(PEER_PORT);
  inet_pton(AF_INET6, CONFIG_NET_CONFIG_PEER_IPV6_ADDR,
            &addr6.sin6_addr);

  return start_udp_proto(AF_INET6,
                         (struct sockaddr *)&addr6,
                         sizeof(addr6));
}

static void stop_udp(void) {
  LOG_INF("Stopping...");
  if (conf.udp_sock >= 0) {
    (void)close(conf.udp_sock);
  }
}
```
