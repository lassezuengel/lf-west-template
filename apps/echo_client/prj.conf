## CMakeLists.txt
```
# SPDX-License-Identifier: Apache-2.0

cmake_minimum_required(VERSION 3.20.0)

find_package(Zephyr REQUIRED HINTS $ENV{ZEPHYR_BASE})
project(sockets_echo_client)

if(CONFIG_NET_SOCKETS_SOCKOPT_TLS AND
   CONFIG_MBEDTLS_KEY_EXCHANGE_PSK_ENABLED AND
   (CONFIG_NET_SAMPLE_PSK_HEADER_FILE STREQUAL "dummy_psk.h"))
  add_custom_target(development_psk
    COMMAND ${CMAKE_COMMAND} -E echo "----------------------------------------------------------"
    COMMAND ${CMAKE_COMMAND} -E echo "--- WARNING: Using dummy PSK! Only suitable for        ---"
    COMMAND ${CMAKE_COMMAND} -E echo "--- development. Set NET_SAMPLE_PSK_HEADER_FILE to use ---"
    COMMAND ${CMAKE_COMMAND} -E echo "--- own pre-shared key.                                ---"
    COMMAND ${CMAKE_COMMAND} -E echo "----------------------------------------------------------"
  )
  add_dependencies(app development_psk)
endif()

target_sources(                     app PRIVATE src/echo-client.c)

include(${ZEPHYR_BASE}/samples/net/common/common.cmake)

set(gen_dir ${ZEPHYR_BINARY_DIR}/include/generated/)

generate_inc_file_for_target(
    app
    src/echo-apps-cert.der
    ${gen_dir}/echo-apps-cert.der.inc
    )
```

## Kconfig
```
# Private config options for echo-client sample app

# Copyright (c) 2018 Intel Corporation
# SPDX-License-Identifier: Apache-2.0

mainmenu "Networking echo-client sample application"

config NET_SAMPLE_SEND_ITERATIONS
	int "Send sample data this many times"
	default 0
	help
	  Send sample data this many times before exiting. A value of
	  zero means that the sample application is run forever.

source "Kconfig.zephyr"
```

## prj.conf
```kconfig
# Generic networking options
CONFIG_NETWORKING=y
CONFIG_NET_TCP=y
CONFIG_NET_IPV6=y
CONFIG_NET_SOCKETS=y
CONFIG_NET_CONNECTION_MANAGER=y

CONFIG_POSIX_API=y

# Kernel options
CONFIG_MAIN_STACK_SIZE=2048
CONFIG_ENTROPY_GENERATOR=y
CONFIG_TEST_RANDOM_GENERATOR=y
CONFIG_INIT_STACKS=y

# Logging
CONFIG_NET_LOG=y
CONFIG_LOG=y
CONFIG_PRINTK=y

# Network buffers
CONFIG_NET_PKT_RX_COUNT=16
CONFIG_NET_PKT_TX_COUNT=16
CONFIG_NET_BUF_RX_COUNT=80
CONFIG_NET_BUF_TX_COUNT=80
CONFIG_NET_CONTEXT_NET_PKT_POOL=y

# IP address options
CONFIG_NET_IF_UNICAST_IPV6_ADDR_COUNT=3
CONFIG_NET_IF_MCAST_IPV6_ADDR_COUNT=4
CONFIG_NET_MAX_CONTEXTS=10
CONFIG_NET_IF_MAX_IPV6_COUNT=3

# Network shell
CONFIG_NET_SHELL=y

# The addresses are selected so that qemu<->qemu connectivity works ok.
# For linux<->qemu connectivity, create a new conf file and swap the
# addresses (so that peer address is ending to 2).
CONFIG_NET_CONFIG_SETTINGS=y
CONFIG_NET_CONFIG_NEED_IPV6=y
CONFIG_NET_CONFIG_MY_IPV6_ADDR="2001:db8::2"
CONFIG_NET_CONFIG_PEER_IPV6_ADDR="2001:db8::1"
CONFIG_NET_CONFIG_NEED_IPV4=y
CONFIG_NET_CONFIG_MY_IPV4_ADDR="192.0.2.2"
CONFIG_NET_CONFIG_PEER_IPV4_ADDR="192.0.2.1"
CONFIG_SYSTEM_WORKQUEUE_STACK_SIZE=2048
```

## overlay-802154.conf
```kconfig
CONFIG_BT=n

# Disable UDP and IPv4
CONFIG_NET_TCP=y
CONFIG_NET_UDP=n
CONFIG_NET_IPV4=n
CONFIG_NET_L2_IEEE802154_FRAGMENT_REASS_CACHE_SIZE=8

CONFIG_NET_CONFIG_NEED_IPV6=y
CONFIG_NET_CONFIG_NEED_IPV4=n
CONFIG_NET_CONFIG_MY_IPV4_ADDR=""
CONFIG_NET_CONFIG_PEER_IPV4_ADDR=""
CONFIG_NET_CONFIG_MY_IPV6_ADDR="2001:db8::2"
CONFIG_NET_CONFIG_PEER_IPV6_ADDR="2001:db8::1"

CONFIG_NET_L2_IEEE802154=y
CONFIG_NET_L2_IEEE802154_SHELL=y

CONFIG_NET_CONFIG_IEEE802154_CHANNEL=26
```

## src/common.h
```c
/*
 * Copyright (c) 2017 Intel Corporation.
 * Copyright (c) 2018 Nordic Semiconductor ASA.
 *
 * SPDX-License-Identifier: Apache-2.0
 */

#include <zephyr/kernel.h>

/* Value of 0 will cause the IP stack to select next free port */
#define MY_PORT 0

#define PEER_PORT 4242

/* Turn off the progress printing so that shell can be used.
 * Set to true if you want to see progress output.
 */
#define PRINT_PROGRESS false

#if defined(CONFIG_USERSPACE)
#include <zephyr/app_memory/app_memdomain.h>
extern struct k_mem_partition app_partition;
extern struct k_mem_domain app_domain;
#define APP_BMEM K_APP_BMEM(app_partition)
#define APP_DMEM K_APP_DMEM(app_partition)
#else
#define APP_BMEM
#define APP_DMEM
#endif

#if defined(CONFIG_NET_TC_THREAD_PREEMPTIVE)
#define THREAD_PRIORITY K_PRIO_PREEMPT(8)
#else
#define THREAD_PRIORITY K_PRIO_COOP(CONFIG_NUM_COOP_PRIORITIES - 1)
#endif

struct sample_data {
	const char *proto;

	struct {
		int sock;
		uint32_t expecting;
		uint32_t received;
		uint32_t counter;
	} tcp;
};

struct configs {
	struct sample_data ipv6;
};

#if !defined(CONFIG_NET_CONFIG_PEER_IPV6_ADDR)
#define CONFIG_NET_CONFIG_PEER_IPV6_ADDR ""
#endif

extern const char lorem_ipsum[];
extern const int ipsum_len;
extern struct configs conf;
```

## src/echo-client.c
```c
/* echo-client.c - Simplified IPv6 TCP echo client */

#include <zephyr/logging/log.h>
LOG_MODULE_REGISTER(net_echo_client_sample, LOG_LEVEL_DBG);

#include <errno.h>
#include <stdio.h>
#include <zephyr/kernel.h>

#include <zephyr/posix/sys/eventfd.h>

#include <zephyr/net/conn_mgr_monitor.h>
#include <zephyr/net/net_event.h>
#include <zephyr/net/net_mgmt.h>
#include <zephyr/net/socket.h>

#include "common.h"

#define APP_BANNER "Run echo client"

#define INVALID_SOCK (-1)

#define EVENT_MASK (NET_EVENT_L4_CONNECTED | NET_EVENT_L4_DISCONNECTED)

const char lorem_ipsum[] = "LOREM_IPSUM";
const int ipsum_len = sizeof(lorem_ipsum) - 1;

APP_DMEM struct configs conf = {
    .ipv6 = {
        .proto = "IPv6",
        .tcp.sock = INVALID_SOCK,
    },
};

static APP_BMEM struct pollfd fds[2];
static APP_BMEM int nfds;

static APP_BMEM bool connected;

K_SEM_DEFINE(run_app, 0, 1);

static struct net_mgmt_event_callback mgmt_cb;

// Prepares the fds for polling.
static void prepare_fds(void) {
  nfds = 0;

  fds[nfds].fd = eventfd(0, 0);
  fds[nfds].events = POLLIN;
  nfds++;

  if (conf.ipv6.tcp.sock >= 0) {
    fds[nfds].fd = conf.ipv6.tcp.sock;
    fds[nfds].events = POLLIN;
    nfds++;
  }
}

// Waits for events on the prepared fds.
static void wait(void) {
  int ret;

  ret = poll(fds, nfds, -1);
  if (ret < 0) {
    LOG_ERR("Error in poll:%d", errno);
    return;
  }

  if (ret > 0 && fds[0].revents) {
    eventfd_t value;
    eventfd_read(fds[0].fd, &value);
    LOG_DBG("Received restart event.");
    return;
  }
}

static int start_tcp(void);
static int process_tcp_proto(struct sample_data *data);
static void stop_tcp(void);

static int start_tcp_and_fds(void) {
  LOG_INF("Starting...");

  int ret = start_tcp();
  if (ret < 0) {
    return ret;
  }

  prepare_fds();

  return 0;
}

static int run_tcp(void) {
  wait();

  int ret = process_tcp_proto(&conf.ipv6);
  if (ret < 0) {
    return ret;
  }

  return 0;
}

// Sets up network event handler for connection management.
// On connection, it gives the semaphore to allow the client to run.
static void event_handler(struct net_mgmt_event_callback *cb,
                          uint32_t mgmt_event, struct net_if *iface) {
  if ((mgmt_event & EVENT_MASK) != mgmt_event) {
    return;
  }

  if (mgmt_event == NET_EVENT_L4_CONNECTED) {
    LOG_INF("Network connected");
    connected = true;
    k_sem_give(&run_app);
    return;
  }

  if (mgmt_event == NET_EVENT_L4_DISCONNECTED) {
    LOG_INF("Network disconnected");
    connected = false;
    k_sem_reset(&run_app);
    return;
  }
}

// Initializes network manager and connection event callback.
static void init_network_manager(void) {
  if (IS_ENABLED(CONFIG_NET_CONNECTION_MANAGER)) {
    net_mgmt_init_event_callback(&mgmt_cb,
                                 event_handler, EVENT_MASK);
    net_mgmt_add_event_callback(&mgmt_cb);

    conn_mgr_mon_resend_status();
  } else {
    connected = true;
    k_sem_give(&run_app);
  }
}

static void start_client() {
  int iterations = CONFIG_NET_SAMPLE_SEND_ITERATIONS;
  int i = 0;
  int ret;

  while (iterations == 0 || i < iterations) {
    k_sem_take(&run_app, K_FOREVER);

    ret = start_tcp_and_fds();

    while (connected && (ret == 0)) {
      ret = run_tcp();

      if (iterations > 0) {
        i++;
        if (i >= iterations) {
          break;
        }
      }
    }

    stop_tcp();
  }
}

int main(void) {
  LOG_INF(APP_BANNER);

  init_network_manager();

  k_thread_priority_set(k_current_get(), THREAD_PRIORITY);

  start_client();
  return 0;
}

/* TCP implementation */

#include <zephyr/random/random.h>

#define RECV_BUF_SIZE 128

static ssize_t sendall(int sock, const void *buf, size_t len) {
  while (len) {
    ssize_t out_len = send(sock, buf, len, 0);

    if (out_len < 0) {
      return out_len;
    }
    buf = (const char *)buf + out_len;
    len -= out_len;
  }

  return 0;
}

static int send_tcp_data(struct sample_data *data) {
  int ret;

  do {
    data->tcp.expecting = sys_rand32_get() % ipsum_len;
  } while (data->tcp.expecting == 0U);

  data->tcp.received = 0U;

  ret = sendall(data->tcp.sock, lorem_ipsum, data->tcp.expecting);

  if (ret < 0) {
    LOG_ERR("%s TCP: Failed to send data, errno %d", data->proto,
            errno);
  }

  return ret;
}

static int compare_tcp_data(struct sample_data *data, const char *buf, uint32_t received) {
  if (data->tcp.received + received > data->tcp.expecting) {
    LOG_ERR("Too much data received: TCP %s", data->proto);
    return -EIO;
  }

  if (memcmp(buf, lorem_ipsum + data->tcp.received, received) != 0) {
    LOG_ERR("Invalid data received: TCP %s", data->proto);
    return -EIO;
  }

  return 0;
}

// Starts TCP connection to the given address and port.
static int start_tcp_proto(struct sample_data *data, sa_family_t family,
                           struct sockaddr *addr, socklen_t addrlen) {
  int ret;

  data->tcp.sock = socket(family, SOCK_STREAM, IPPROTO_TCP);
  if (data->tcp.sock < 0) {
    LOG_ERR("Failed to create TCP socket (%s): %d", data->proto,
            errno);
    return -errno;
  }

  ret = connect(data->tcp.sock, addr, addrlen);
  if (ret < 0) {
    LOG_ERR("Cannot connect to TCP remote (%s): %d", data->proto,
            errno);
    ret = -errno;
  }

  return ret;
}

static int process_tcp_proto(struct sample_data *data) {
  int ret, received;
  char buf[RECV_BUF_SIZE];

  do {
    received = recv(data->tcp.sock, buf, sizeof(buf), MSG_DONTWAIT);

    if (received == 0) {
      ret = -EIO;
      continue;
    } else if (received < 0) {
      if (errno == EAGAIN || errno == EWOULDBLOCK) {
        ret = 0;
      } else {
        ret = -errno;
      }
      continue;
    }

    ret = compare_tcp_data(data, buf, received);
    if (ret != 0) {
      break;
    }

    data->tcp.received += received;
    if (data->tcp.received < data->tcp.expecting) {
      continue;
    }

    if (++data->tcp.counter % 1000 == 0U) {
      LOG_INF("%s TCP: Exchanged %u packets", data->proto,
              data->tcp.counter);
    }

    ret = send_tcp_data(data);
    break;
  } while (received > 0);

  return ret;
}

// Starts TCP connection to the server and kicks off data exchange.
static int start_tcp(void) {
  int ret = 0;
  struct sockaddr_in6 addr6;

  addr6.sin6_family = AF_INET6;
  addr6.sin6_port = htons(PEER_PORT);
  inet_pton(AF_INET6, CONFIG_NET_CONFIG_PEER_IPV6_ADDR,
            &addr6.sin6_addr);

  ret = start_tcp_proto(&conf.ipv6, AF_INET6,
                        (struct sockaddr *)&addr6,
                        sizeof(addr6));
  if (ret < 0) {
    return ret;
  }

  // Kick off the data exchange by sending
  // the first chunk of data to the server.
  return send_tcp_data(&conf.ipv6);
}

static void stop_tcp(void) {
  LOG_INF("Stopping...");
  if (conf.ipv6.tcp.sock >= 0) {
    (void)close(conf.ipv6.tcp.sock);
  }
}
```
