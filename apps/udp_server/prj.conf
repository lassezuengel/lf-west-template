## CMakeLists.txt
```
# SPDX-License-Identifier: Apache-2.0

cmake_minimum_required(VERSION 3.20.0)

find_package(Zephyr REQUIRED HINTS $ENV{ZEPHYR_BASE})
project(sockets_udp_server)

if(CONFIG_NET_SOCKETS_SOCKOPT_TLS AND
   CONFIG_MBEDTLS_KEY_EXCHANGE_PSK_ENABLED AND
   (CONFIG_NET_SAMPLE_PSK_HEADER_FILE STREQUAL "dummy_psk.h"))
  add_custom_target(development_psk
    COMMAND ${CMAKE_COMMAND} -E echo "----------------------------------------------------------"
    COMMAND ${CMAKE_COMMAND} -E echo "--- WARNING: Using dummy PSK! Only suitable for        ---"
    COMMAND ${CMAKE_COMMAND} -E echo "--- development. Set NET_SAMPLE_PSK_HEADER_FILE to use ---"
    COMMAND ${CMAKE_COMMAND} -E echo "--- own pre-shared key.                                ---"
    COMMAND ${CMAKE_COMMAND} -E echo "----------------------------------------------------------"
  )
  add_dependencies(app development_psk)
endif()

target_sources(                     app PRIVATE src/udp-server.c)
target_sources_ifdef(CONFIG_NET_L2_IPIP app PRIVATE src/tunnel.c)

if (CONFIG_USB_DEVICE_STACK)
  target_sources(app PRIVATE src/usb.c)
endif()

if (CONFIG_USB_DEVICE_STACK_NEXT)
  target_sources(app PRIVATE src/usb.c)
  include(${ZEPHYR_BASE}/samples/subsys/usb/common/common.cmake)
endif()

include(${ZEPHYR_BASE}/samples/net/common/common.cmake)

set(gen_dir ${ZEPHYR_BINARY_DIR}/include/generated/)

zephyr_linker_section_ifdef(CONFIG_NET_SAMPLE_WEBSOCKET_CONSOLE NAME
			    http_resource_desc_ws_console_service
			    KVMA RAM_REGION GROUP RODATA_REGION
			    SUBALIGN Z_LINK_ITERABLE_SUBALIGN)
```

## Kconfig
```
# Private config options for echo-server sample app

# Copyright (c) 2018 Intel Corporation
# SPDX-License-Identifier: Apache-2.0

mainmenu "Networking echo-server sample application"

config NET_SAMPLE_NUM_HANDLERS
	int "How many connections to serve at the same time"
	default 1
	help
	  Each connection is served by a thread which needs
	  memory. Only increase the value here if really needed.

config UDP_SERVER_SEND_REPLIES
	bool "Send UDP replies to clients"
	default y
	help
	  If enabled, the UDP server sends a response payload back to
	  clients after receiving a packet. If disabled, received packets
	  are only logged and no response is sent.

source "Kconfig.zephyr"
```

## prj.conf
```kconfig
# Generic networking options
CONFIG_NETWORKING=y
CONFIG_NET_TCP=y
CONFIG_NET_IPV6=y
CONFIG_NET_SOCKETS=y
CONFIG_NET_CONNECTION_MANAGER=y

CONFIG_POSIX_API=y

# Kernel options
CONFIG_MAIN_STACK_SIZE=2048
CONFIG_INIT_STACKS=y

# Logging
CONFIG_NET_LOG=y
CONFIG_LOG=y
CONFIG_PRINTK=y

# Network buffers
CONFIG_NET_PKT_RX_COUNT=16
CONFIG_NET_PKT_TX_COUNT=16
CONFIG_NET_BUF_RX_COUNT=64
CONFIG_NET_BUF_TX_COUNT=64
CONFIG_NET_CONTEXT_NET_PKT_POOL=y

# IP address options
CONFIG_NET_IF_UNICAST_IPV6_ADDR_COUNT=3
CONFIG_NET_IF_MCAST_IPV6_ADDR_COUNT=4
CONFIG_NET_MAX_CONTEXTS=10

# Network shell
CONFIG_NET_SHELL=y
CONFIG_SHELL=y

# Network application options and configuration
CONFIG_NET_CONFIG_SETTINGS=y
CONFIG_NET_CONFIG_NEED_IPV6=y
CONFIG_NET_CONFIG_MY_IPV6_ADDR="fd01::1"

# Number of socket descriptors might need adjusting
# if there are more than 1 handlers defined.
CONFIG_ZVFS_OPEN_MAX=12

# How many client can connect to echo-server simultaneously
CONFIG_NET_SAMPLE_NUM_HANDLERS=1

# Application behavior options
CONFIG_UDP_SERVER_SEND_REPLIES=n


CONFIG_NET_IPV6_ND=n
CONFIG_NET_IPV6_NBR_CACHE=n
```

## overlay-802154.conf
```kconfig
CONFIG_BT=n

# Disable TCP and IPv4
CONFIG_NET_TCP=n
CONFIG_NET_UDP=y
CONFIG_NET_IPV4=n
CONFIG_NET_L2_IEEE802154_FRAGMENT_REASS_CACHE_SIZE=8

CONFIG_NET_CONFIG_NEED_IPV6=y
CONFIG_NET_CONFIG_NEED_IPV4=n
CONFIG_NET_CONFIG_MY_IPV4_ADDR=""
CONFIG_NET_CONFIG_PEER_IPV4_ADDR=""

CONFIG_NET_L2_IEEE802154=y
CONFIG_NET_L2_IEEE802154_SHELL=y

CONFIG_NET_CONFIG_IEEE802154_CHANNEL=26

CONFIG_SYSTEM_WORKQUEUE_STACK_SIZE=2048
```

## src/common.h
```c
#ifndef UDP_SERVER_COMMON_H
#define UDP_SERVER_COMMON_H

#if defined(CONFIG_NET_SOCKETS_SOCKOPT_TLS) || defined(CONFIG_NET_TCP) || \
	defined(CONFIG_COVERAGE_GCOV)
#define STACK_SIZE 4096
#else
#define STACK_SIZE 2048
#endif

#if defined(CONFIG_NET_TC_THREAD_PREEMPTIVE)
#define THREAD_PRIORITY K_PRIO_PREEMPT(8)
#else
#define THREAD_PRIORITY K_PRIO_COOP(CONFIG_NUM_COOP_PRIORITIES - 1)
#endif

// The server data, including app data and configuration data.
struct data {
  const char *proto;

  int udp_sock;
};

void start_udp(void);
void stop_udp(void);

#endif /* UDP_SERVER_COMMON_H */
```

## src/udp-server.c
```c
/* udp-server.c - Simplified IPv6 UDP echo server */
/* This is actually a receiver of data, but persistent,
   so we call it the server. */

#include <zephyr/logging/log.h>
LOG_MODULE_REGISTER(net_udp_server_sample, LOG_LEVEL_INF);

#include <errno.h>
#include <zephyr/kernel.h>
#include <zephyr/linker/sections.h>
#include <zephyr/posix/poll.h>
#include <zephyr/shell/shell.h>
#include <zephyr/sys/util.h>

#include <zephyr/net/net_core.h>
#include <zephyr/net/socket.h>
#include <zephyr/net/conn_mgr_monitor.h>
#include <zephyr/net/net_event.h>
#include <zephyr/net/net_mgmt.h>

#include "common.h"

static struct k_sem quit_lock;
static struct net_mgmt_event_callback mgmt_cb;
static bool connected;
K_SEM_DEFINE(run_app, 0, 1);
static bool want_to_quit = false;

#define EVENT_MASK (NET_EVENT_L4_CONNECTED | NET_EVENT_L4_DISCONNECTED)

// Network management event callback handler.
static void event_handler(struct net_mgmt_event_callback *cb,
                          uint32_t mgmt_event, struct net_if *iface) {
  ARG_UNUSED(iface);
  ARG_UNUSED(cb);

  if ((mgmt_event & EVENT_MASK) != mgmt_event) {
    return;
  }

  if (want_to_quit) {
    k_sem_give(&run_app);
    want_to_quit = false;
  }

  if (mgmt_event == NET_EVENT_L4_CONNECTED) {
    LOG_INF("Network connected");

    connected = true;
    k_sem_give(&run_app);

    return;
  }

  if (mgmt_event == NET_EVENT_L4_DISCONNECTED) {
    if (connected == false) {
      LOG_INF("Waiting network to be connected");
    } else {
      LOG_INF("Network disconnected");
      connected = false;
    }

    k_sem_reset(&run_app);

    return;
  }
}

// Initializes the connection manager.
static void init_connection_manager(void) {
  k_sem_init(&quit_lock, 0, K_SEM_MAX_LIMIT);

  if (IS_ENABLED(CONFIG_NET_CONNECTION_MANAGER)) {
    net_mgmt_init_event_callback(&mgmt_cb,
                                 event_handler, EVENT_MASK);
    net_mgmt_add_event_callback(&mgmt_cb);

    conn_mgr_mon_resend_status();
  } else {
    k_sem_give(&run_app);
  }
}

int main(void) {
  LOG_INF("What's up? UDP server started!");

  init_connection_manager();

  k_sem_take(&run_app, K_FOREVER);

  start_udp();

  k_sem_take(&quit_lock, K_FOREVER);

  if (connected) {
    stop_udp();
  }
  return 0;
}

/* UDP implementation */

// Creates and binds UDP listening socket.
static int start_udp_proto(struct data *data,
                           struct sockaddr *bind_addr,
                           socklen_t bind_addrlen) {
  int optval;
  int ret;

  data->udp_sock = socket(bind_addr->sa_family, SOCK_DGRAM,
                          IPPROTO_UDP);
  if (data->udp_sock < 0) {
    LOG_ERR("Failed to create UDP socket (%s): %d", data->proto,
            errno);
    return -errno;
  }

  if (bind_addr->sa_family == AF_INET6) {
    optval = IPV6_PREFER_SRC_PUBLIC;
    (void)setsockopt(data->udp_sock, IPPROTO_IPV6,
                     IPV6_ADDR_PREFERENCES,
                     &optval, sizeof(optval));

    optval = 1;
    (void)setsockopt(data->udp_sock, IPPROTO_IPV6, IPV6_V6ONLY,
                     &optval, sizeof(optval));
  }

  ret = bind(data->udp_sock, bind_addr, bind_addrlen);
  if (ret < 0) {
    LOG_ERR("Failed to bind UDP socket (%s): %d", data->proto,
            errno);
    return -errno;
  }

  return ret;
}

struct data conf = {
  .proto = "IPv6",
  .udp_sock = -1,
};

static ssize_t sendall(const void *buf, size_t len, struct sockaddr *addr, socklen_t addrlen) {
  while (len) {
    ssize_t out_len = sendto(conf.udp_sock, buf, len, 0, addr, addrlen);

    if (out_len < 0) {
      return out_len;
    }
    buf = (const char *)buf + out_len;
    len -= out_len;
  }

  return 0;
}

static void log_server_rx_rate(uint32_t *packets_last_sec,
                               int64_t *last_log_ms) {
  int64_t now = k_uptime_get();

  while ((now - *last_log_ms) >= 1000) {
    LOG_INF("Client->server rate: received %u packets in last second",
            *packets_last_sec);
    *packets_last_sec = 0;
    *last_log_ms += 1000;
  }
}

void start_udp() {
  struct sockaddr_in6 addr6;

  (void)memset(&addr6, 0, sizeof(addr6));
  addr6.sin6_family = AF_INET6;
  addr6.sin6_port   = htons(4242);

  inet_pton(AF_INET6, CONFIG_NET_CONFIG_MY_IPV6_ADDR, &addr6.sin6_addr);

  if(start_udp_proto(&conf, (struct sockaddr *)&addr6, sizeof(addr6)) < 0) {
    LOG_ERR("Failed to start UDP server");
    return;
  }

  LOG_INF("UDP server started on port %d", ntohs(addr6.sin6_port));

  struct sockaddr_in6 client_addr6;
  uint32_t rx_packets_last_sec = 0;
  int64_t last_rate_log_ms = k_uptime_get();

  while(true) {
    int ret;
    struct pollfd fds[1];
    int64_t now = k_uptime_get();
    int64_t until_rate_log = 1000 - (now - last_rate_log_ms);
    int poll_timeout_ms = (until_rate_log <= 0) ? 0 : (int)until_rate_log;
    socklen_t client_addr_len = sizeof(client_addr6);

    fds[0].fd = conf.udp_sock;
    fds[0].events = POLLIN;

    ret = poll(fds, 1, poll_timeout_ms);
    if (ret < 0) {
      LOG_ERR("Poll error: %d", -errno);
      continue;
    }

    log_server_rx_rate(&rx_packets_last_sec, &last_rate_log_ms);

    if (ret == 0) {
      continue;
    }

    char buffer[128];
    ssize_t recv_len = recvfrom(conf.udp_sock, buffer, sizeof(buffer) - 1, 0,
                                (struct sockaddr *)&client_addr6, &client_addr_len);

    if (recv_len < 0) {
      LOG_ERR("Receive error: %d", -errno);
      continue;
    }

    rx_packets_last_sec++;

    LOG_DBG("Received %d bytes: %.*s", recv_len, (int)recv_len, buffer);

    if (!IS_ENABLED(CONFIG_UDP_SERVER_SEND_REPLIES)) {
      LOG_DBG("Reply disabled by CONFIG_UDP_SERVER_SEND_REPLIES");
      continue;
    }

    char message[] = "Okay";
    ssize_t sent_len = sendall(message, sizeof(message), (struct sockaddr *)&client_addr6, sizeof(client_addr6));

    if (sent_len < 0) {
      LOG_ERR("Send error: %d", -errno);
      continue;
    }

    char addr_str_client[NET_IPV6_ADDR_LEN];
    LOG_INF("Sent %d bytes response to %s",
          (int)sizeof(message),
          net_addr_ntop(AF_INET6, &client_addr6.sin6_addr, addr_str_client, sizeof(addr_str_client)));
  }
}

void stop_udp() {
  LOG_INF("Stopping UDP server");
  if (conf.udp_sock >= 0) {
    close(conf.udp_sock);
    conf.udp_sock = -1;
  }
}
```
